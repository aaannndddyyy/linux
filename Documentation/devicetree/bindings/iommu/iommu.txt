## fs/ceph/Kconfig
```kconfig
config CEPH_FS
	tristate "Ceph distributed file system"
	depends on INET
	select CEPH_LIB
	select LIBCRC32C
	select CRYPTO_AES
	select CRYPTO
	default n
	help
	  Choose Y or M here to include support for mounting the
	  experimental Ceph distributed file system.  Ceph is an extremely
	  scalable file system designed to provide high performance,
	  reliable access to petabytes of storage.

	  More information at http://ceph.newdream.net/.

	  If unsure, say N.

config ROOT_CEPH
	bool "Root file system on Ceph FS"
	depends on CEPH_FS=y && IP_PNP
	help
	  If you want your system to mount its root file system via CEPH,
	  choose Y here.  For details, read
	  <file:Documentation/filesystems/ceph/cephroot.txt>.

	  If unsure say N.
```
