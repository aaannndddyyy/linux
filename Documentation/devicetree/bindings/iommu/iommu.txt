## Documentation/devicetree/bindings/iommu/iommu.txt
```
This document describes the generic device tree binding for IOMMUs and their
master(s).


IOMMU device node:
==================

An IOMMU can provide the following services:

* Remap address space to allow devices to access physical memory ranges that
  they otherwise wouldn't be capable of accessing.

  Example: 32-bit DMA to 64-bit physical addresses

* Implement scatter-gather at page level granularity so that the device does
  not have to.

* Provide system protection against "rogue" DMA by forcing all accesses to go
  through the IOMMU and faulting when encountering accesses to unmapped
  address regions.

* Provide address space isolation between multiple contexts.

  Example: Virtualization

Device nodes compatible with this binding represent hardware with some of the
above capabilities.

IOMMUs can be single-master or multiple-master. Single-master IOMMU devices
typically have a fixed association to the master device, whereas multiple-
master IOMMU devices can translate accesses from more than one master.

The device tree node of the IOMMU device's parent bus must contain a valid
"dma-ranges" property that describes how the physical address space of the
IOMMU maps to memory. An empty "dma-ranges" property means that there is a
1:1 mapping from IOMMU to memory.

Required properties:
--------------------
- #address-cells: The number of cells in an IOMMU specifier needed to encode
  an address.
- #size-cells: The number of cells in an IOMMU specifier needed to represent
  the length of an address range.

Typical values for the above include:
- #address-cells = <0>, size-cells = <0>: Single master IOMMU devices are not
  configurable and therefore no additional information needs to be encoded in
  the specifier. This may also apply to multiple master IOMMU devices that do
  not allow the association of masters to be configured.
- #address-cells = <1>, size-cells = <0>: Multiple master IOMMU devices may
  need to be configured in order to enable translation for a given master. In
  such cases the single address cell corresponds to the master device's ID.
- #address-cells = <2>, size-cells = <2>: Some IOMMU devices allow the DMA
  window for masters to be configured. The first cell of the address in this
  may contain the master device's ID for example, while the second cell could
  contain the start of the DMA window for the given device. The length of the
  DMA window is specified by two additional cells.


IOMMU master node:
==================

Devices that access memory through an IOMMU are called masters. A device can
have multiple master interfaces (to one or more IOMMU devices).

Required properties:
--------------------
- iommus: A list of phandle and IOMMU specifier pairs that describe the IOMMU
  master interfaces of the device. One entry in the list describes one master
  interface of the device.

When an "iommus" property is specified in a device tree node, the IOMMU will
be used for address translation. If a "dma-ranges" property exists in the
device's parent node it will be ignored. An exception to this rule is if the
referenced IOMMU is disabled, in which case the "dma-ranges" property of the
parent shall take effect.

Optional properties:
--------------------
- iommu-names: A list of names identifying each entry in the "iommus"
  property.


Notes:
======

One possible extension to the above is to use an "iommus" property along with
a "dma-ranges" property in a bus device node (such as PCI host bridges). This
can be useful to describe how children on the bus relate to the IOMMU if they
are not explicitly listed in the device tree (e.g. PCI devices). However, the
requirements of that use-case haven't been fully determined yet. Implementing
this is therefore not recommended without further discussion and extension of
this binding.


Examples:
=========

Single-master IOMMU:
--------------------

	iommu {
		#address-cells = <0>;
		#size-cells = <0>;
	};

	master {
		iommus = <&/iommu>;
	};

Multiple-master IOMMU with fixed associations:
----------------------------------------------

	/* multiple-master IOMMU */
	iommu {
		/*
		 * Masters are statically associated with this IOMMU and
		 * address translation is always enabled.
		 */
		#address-cells = <0>;
		#size-cells = <0>;
	};

	/* static association with IOMMU */
	master@1 {
		reg = <1>;
		iommus = <&/iommu>;
	};

	/* static association with IOMMU */
	master@2 {
		reg = <2>;
		iommus = <&/iommu>;
	};

Multiple-master IOMMU:
----------------------

	iommu {
		/* the specifier represents the ID of the master */
		#address-cells = <1>;
		#size-cells = <0>;
	};

	master {
		/* device has master ID 42 in the IOMMU */
		iommus = <&/iommu 42>;
	};

Multiple-master IOMMU with configurable DMA window:
---------------------------------------------------

	/ {
		#address-cells = <1>;
		#size-cells = <1>;

		iommu {
			/* master ID, address of DMA window */
			#address-cells = <2>;
			#size-cells = <2>;
		};

		master {
			/* master ID 42, 4 GiB DMA window starting at 0 */
			iommus = <&/iommu  42 0  0x1 0x0>;
		};
	};
```

## arch/arm/configs/csb1724_defconfig
```kconfig
CONFIG_ARCH_KIRKWOOD=y
CONFIG_ARCH_KIRKWOOD_DT=y
CONFIG_MACH_CSB1724_DT=y
CONFIG_EMBEDDED=y
CONFIG_EXPERT=y
CONFIG_EXPERIMENTAL=y
CONFIG_ARM_APPENDED_DTB=y
CONFIG_VFP=y
CONFIG_AEABI=y
CONFIG_OABI_COMPAT=y
CONFIG_SERIAL_8250=y
CONFIG_SERIAL_8250_CONSOLE=y
CONFIG_SERIAL_OF_PLATFORM=y
CONFIG_ATA=y
CONFIG_ATA_SFF=y
CONFIG_ATA_BMDMA=y
CONFIG_SATA_MV=y
CONFIG_MSDOS_FS=y
CONFIG_VFAT_FS=y
CONFIG_TMPFS=y
CONFIG_NLS_CODEPAGE_437=y
CONFIG_NLS_CODEPAGE_850=y
CONFIG_NLS_ISO8859_1=y
CONFIG_NLS_ISO8859_2=y
CONFIG_NLS_UTF8=y
CONFIG_MAGIC_SYSRQ=y
CONFIG_DEBUG_FS=y
CONFIG_TIMER_STATS=y
CONFIG_DEBUG_INFO=y
CONFIG_DEBUG_USER=y
CONFIG_DEBUG_LL=y
CONFIG_EARLY_PRINTK=y
CONFIG_DTC=y
CONFIG_SCSI=y
CONFIG_BLK_DEV_SD=y
CONFIG_EXT4_FS=y
CONFIG_SYSVIPC=y
CONFIG_SYSVIPC_SYSCTL=y
CONFIG_TICK_ONESHOT=y
CONFIG_NO_HZ=y
CONFIG_HIGH_RES_TIMERS=y
CONFIG_MODULES=y
CONFIG_MODULE_UNLOAD=y
CONFIG_PROC_DEVICETREE=y
CONFIG_BLK_DEV_LOOP=y
CONFIG_BLK_DEV_LOOP_MIN_COUNT=8
CONFIG_DYNAMIC_DEBUG=y
CONFIG_NET=y
CONFIG_INET=y
CONFIG_NETDEVICES=y
CONFIG_MV643XX_ETH=y
CONFIG_PACKET=y
CONFIG_UNIX=y
CONFIG_IPV6=n
CONFIG_NET_VENDOR_3COM=n
CONFIG_NET_VENDOR_ADAPTEC=n
CONFIG_NET_VENDOR_ALTEON=n
CONFIG_NET_VENDOR_AMD=n
CONFIG_NET_VENDOR_ATHEROS=n
CONFIG_NET_VENDOR_BROADCOM=n
CONFIG_NET_VENDOR_BROCADE=n
CONFIG_NET_VENDOR_CHELSIO=n
CONFIG_NET_VENDOR_CIRRUS=n
CONFIG_NET_VENDOR_CISCO=n
CONFIG_NET_VENDOR_DEC=n
CONFIG_NET_VENDOR_HP=n
CONFIG_NET_VENDOR_DLINK=n
CONFIG_NET_VENDOR_EMULEX=n
CONFIG_NET_VENDOR_EXAR=n
CONFIG_NET_VENDOR_FARADAY=n
CONFIG_NET_VENDOR_INTEL=n
CONFIG_NET_VENDOR_MELLANOX=n
CONFIG_NET_VENDOR_MICREL=n
CONFIG_NET_VENDOR_MYRI=n
CONFIG_NET_VENDOR_NATSEMI=n
CONFIG_NET_VENDOR_NVIDIA=n
CONFIG_NET_VENDOR_OKI=n
CONFIG_NET_PACKET_ENGINE=n
CONFIG_NET_VENDOR_QLOGIC=n
CONFIG_NET_VENDOR_REALTEK=n
CONFIG_NET_VENDOR_RDC=n
CONFIG_NET_VENDOR_SEEQ=n
CONFIG_NET_VENDOR_SILAN=n
CONFIG_NET_VENDOR_SIS=n
CONFIG_NET_VENDOR_SMSC=n
CONFIG_NET_VENDOR_STMICRO=n
CONFIG_NET_VENDOR_SUN=n
CONFIG_NET_VENDOR_TEHUTI=n
CONFIG_NET_VENDOR_TI=n
CONFIG_NET_VENDOR_VIA=n
CONFIG_NET_VENDOR_WIZNET=n
```
